## Kconfig
```kconfig
# Sensor data simulator
#
# Copyright (c) 2019 Nordic Semiconductor
#
# SPDX-License-Identifier: LicenseRef-Nordic-5-Clause
#

menuconfig PMW3360
    bool "PMW3360 mouse optical sensor"
  select SPI
    help
      Enable PMW3360 mouse optical sensor.

if PMW3360

config PMW3360_SMART_ALGORITHM
  bool "Enable an algorithm of PMW3360 to enhance surface coverage"
  default y
  help
    Enable the integration of the smart algorithm as the datasheet implementation.
    The algorithm is used to extend the tracking acrocss a wider range of surfaces
    such as graniles and tiles.

config PMW3360_CPI
    int "PMW3360's default CPI"
    default 800
    range 200 3200
    help
      Default CPI value, with 200 step

config PMW3360_CPI_DIVIDOR
    int "PMW3360's default CPI dividor"
    default 1
    range 1 100
    help
      Default CPI dividor value.

config PMW3360_SNIPE_CPI
    int "PMW3360's CPI in snipe mode"
    default 200
    range 200 3200
    help
      Snipe CPI value, with 200 step

config PMW3360_SNIPE_CPI_DIVIDOR
    int "PMW3360's CPI dividor in snipe mode"
    default 1
    range 1 100
    help
      Snipe CPI dividor value.

config PMW3360_SCROLL_TICK
    int "PMW3360's required ticks to produce a scroll report"
    default 20
    help
      Scroll tick value.

choice
    prompt "Select PMW3360's polling rate"
    default PMW3360_POLLING_RATE_250

config PMW3360_POLLING_RATE_250
    bool "250 Hz"

config PMW3360_POLLING_RATE_125
    bool "125 Hz"

config PMW3360_POLLING_RATE_125_SW
    bool "125 Hz with software implementation"

endchoice

config PMW3360_FORCE_AWAKE
    bool "PMW3360 forced awake mode"
    help
      This setting forces the sensor to always be in the RUN state.

config PMW3360_RUN_DOWNSHIFT_TIME_MS
    int "PMW3360's default RUN mode downshift time"
    default 128
    range 13 3264
    help
      Default RUN mode downshift down time in milliseconds.
      Time after which sensor goes from RUN to REST1 mode.

config PMW3360_REST1_SAMPLE_TIME_MS
    int "PMW3360's sample time in REST1 stage"
    default 40
    range 10 2550
    help
      Default REST1 mode sample period in millisecond

config PMW3360_REST1_DOWNSHIFT_TIME_MS
    int "PMW3360's default REST1 mode downshift time"
    default 9600
    help
      Default REST1 mode downshift down time in milliseconds.
      Time after which sensor goes from REST1 to REST2 mode.

config PMW3360_REST2_SAMPLE_TIME_MS
    int "PMW3360's sample time in REST2 stage"
    default 0
    range 0 2550
    help
      Default REST2 mode sample period in millisecond.
      Minimum value is 10.
      No optimal value provided by datasheet.

config PMW3360_REST2_DOWNSHIFT_TIME_MS
    int "PMW3360's default REST2 mode downshift time"
    default 0
    help
      Default REST2 mode downshift down time in milliseconds.
      Time after which sensor goes from REST2 to REST3 mode.
      No optimal value provided by datasheet.

config PMW3360_REST3_SAMPLE_TIME_MS
    int "PMW3360's sample time in REST3 stage"
    default 0
    range 0 2550
    help
      Default REST2 mode sample period in millisecond.
      Minimum value is 10.
      No optimal value provided by datasheet.

choice
    prompt "Select PMW3360 sensor orientation"
    default PMW3360_ORIENTATION_0

config PMW3360_ORIENTATION_0
    bool "PMW3360 not rotated"

config PMW3360_ORIENTATION_90
    bool "PMW3360 rotated 90 deg clockwise"

config PMW3360_ORIENTATION_180
    bool "PMW3360 rotated 180 deg clockwise"

config PMW3360_ORIENTATION_270
    bool "PMW3360 rotated 270 deg clockwise"

endchoice

config PMW3360_INVERT_X
  bool "Invert the X axis of PMW3360 sensor"

config PMW3360_INVERT_Y
  bool "Invert the Y axis of PMW3360 sensor"

config PMW3360_INVERT_SCROLL_X
  bool "Invert the X axis of the scroll"
  default PMW3360_INVERT_X

config PMW3360_INVERT_SCROLL_Y
  bool "Invert the Y axis of the scroll"
  default PMW3360_INVERT_Y

config PMW3360_AUTOMOUSE_TIMEOUT_MS
  int "Amount of milliseconds the mouse layer will be active after using the trackball"
  default 400

config PMW3360_MOVEMENT_THRESHOLD
    int "Movement threshold for automatic mouse layer activation"
    default 5
    help
        The threshold for trackball movement that triggers the automatic mouse layer.
        A higher value means more movement is required to activate the mouse layer.
        This helps prevent accidental activation during typing.

config PMW3360_BALL_ACTION_TICK
    int "PMW3360's required ticks to trigger a ball action"
    default 20
    help
        Ball action tick value. Higher values require more movement to trigger a ball action.

module = PMW3360
module-str = PMW3360
source "${ZEPHYR_BASE}/subsys/logging/Kconfig.template.log_config"

endif #PMW3360
```
